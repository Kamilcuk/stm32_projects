## kcnuttx/apps/kcapps/test1/Kconfig
```kconfig
#!kconfig

config KCAPPS_TEST1
	bool "This is application test1 compiled from kcapps/test1."
	default n
	---help---
		Enable application residing in "kcapps/test1"

if KCAPPS_TEST1

config KCAPPS_TEST1_PROGNAME
	string "Program name"
	default "test1"
	depends on BUILD_KERNEL
	---help---
		This is the name of the program that will be use when the NSH ELF
		program is installed.

config KCAPPS_TEST1_PRIORITY
	int "test1 task priority"
	default 100

config KCAPPS_TEST1_STACKSIZE
	int "test1 stack size"
	default 2048

endif
```

## src/apps/kcapps/example/Kconfig
```kconfig
#!kconfig

config KCAPPS_EXAMPLE
	bool "This is application example compiled from kcapps/example."
	default n
	---help---
		Enable application residing in "kcapps/example"

if KCAPPS_EXAMPLE

config KCAPPS_EXAMPLE_PROGNAME
	string "Program name"
	default "example"
	depends on BUILD_KERNEL
	---help---
		This is the name of the program that will be use when the NSH ELF
		program is installed.

config KCAPPS_EXAMPLE_PRIORITY
	int "example task priority"
	default 100

config KCAPPS_EXAMPLE_STACKSIZE
	int "example stack size"
	default 2048

endif
```
